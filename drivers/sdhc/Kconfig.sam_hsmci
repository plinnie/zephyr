## drivers/sdhc/Kconfig.sam_hsmci
```kconfig
# Copyright 2022 Nikhef
# SPDX -License-Identifier: Apache-2.0

config SAM_HSMCI
	bool "ATMEL SAM HSMCI driver"
	select SDHC_SUPPORTS_NATIVE_MODE
	help
	  Enable the ATMEL SAM HSMCI MMC/SD card driver.
```

## drivers/sensor/tmp100/Kconfig
```kconfig
# TMP007 infrared thermopile sensor configuration options

# Copyright (c) 2016 Intel Corporation
# SPDX-License-Identifier: Apache-2.0

menuconfig TMP100
	bool "TMP100 Temperature sensor on chip"
	default y
	depends on DT_HAS_TI_TMP100_ENABLED
	select I2C
	help
	  Enable driver for TMP100 on chip sensors.
```

## dts/bindings/sdhc/atmel,sam-hsmci.yaml
```yaml
# Copyright 2022, Nikhef
# SPDX-License-Identifier: Apache-2.0

description: ATMEL (Microchip) SAM HSMCI SD host controller

compatible: "atmel,sam-hsmci"

include: [sdhc.yaml, pinctrl-device.yaml]

properties:
  reg:
    required: true

  pinctrl-0:
    required: true

  pinctrl-names:
    required: true

  peripheral-id:
    required: true
    type: int
  
  cd-gpios:
    required: false
    type: phandle-array
```

## dts/bindings/sensor/ti,tmp100.yml
```yaml
# Copyright (c) 2023, Nikhef Amsterdam
# SPDX-License-Identifier: Apache-2.0

description: |
    TMP100 Digital Temperature Sensor. See datasheet at
    https://www.ti.com/lit/ds/symlink/tmp100.pdf

compatible: "ti,tmp100"

include: [sensor-device.yaml, i2c-device.yaml]

properties:
  resolution:
    type: int
    description: |
     The converter resolution in number of bit between 9 and 12
 
```
